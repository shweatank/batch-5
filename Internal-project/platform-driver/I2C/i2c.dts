/dts-v1/;
/plugin/;

/ {
    compatible = "brcm,bcm2711";

    fragment@0 {
        target = <&i2c1>;
        __overlay__ {

            #address-cells = <1>;
            #size-cells = <0>;

            status = "okay";

            oled: oled@3c {
                compatible = "my,my_i2c";
                reg = <0x3c>;
                status = "okay";
            };
        };
    };
};

