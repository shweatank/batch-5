/dts-v1/;
/plugin/;

/ {
    compatible = "brcm,bcm2711";

    fragment@0 {
        target = <&gpio>;
        __overlay__ {
            isr_gpio_pin: gpio5 {
                gpio-hog;
                gpios = <5 0>; /* GPIO5, input */
                input;
                label = "ISR_GPIO5";
            };
        };
    };
};

