/dts-v1/;
/plugin/;

/ {
    compatible = "brcm,bcm2711";

    fragment@0 {
        target = <&i2c_arm>;

        __overlay__ {
            #address-cells = <1>;
            #size-cells = <0>;

            ssd1306@3c {
                compatible = "my_i2c,ssd1306";
                reg = <0x3c>;
                status = "okay";
            };
        };
    };
};

