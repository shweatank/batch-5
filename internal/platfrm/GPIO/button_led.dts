/dts-v1/;
/plugin/;

/ {
    compatible = "brcm,bcm2711";

    fragment@0 {
        target-path = "/";

        __overlay__ {

            led_gpio17 {
                compatible = "raspi,gpio_button";
                gpios = <&gpio 17 0>;
                label = "button";
                status = "okay";
            };
        };
    };
};
