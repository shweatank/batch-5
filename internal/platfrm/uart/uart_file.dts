/dts-v1/;
/plugin/;

/ {
    compatible = "brcm,bcm2711";

    fragment@0 {
        target = <&uart0>;
        __overlay__ {
            compatible = "my_uart";
            status = "okay";
        };
    };
};
