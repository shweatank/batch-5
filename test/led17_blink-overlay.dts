/dts-v1/;
/plugin/;

/ {
    compatible = "brcm,bcm2835";

    fragment@0 {
        target-path = "/";

        __overlay__ {
            leds {
                compatible = "gpio-leds";

                led17: led17 {
                    label = "LED17";
                    gpios = <&gpio 17 0>;          /* GPIO17 */
                    default-state = "off";
                    linux,default-trigger = "timer"; /* makes it blink */
                };
            };
        };
    };
};
