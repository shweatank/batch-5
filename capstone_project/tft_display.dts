/dts-v1/;
/plugin/;

&spi0 {
    status = "okay";

    ili9225@0 {
        compatible = "my,ili9225";
        reg = <0>;              // CE0
        spi-max-frequency = <8000000>;

        dc-gpios = <&gpio 25 0>;
        reset-gpios = <&gpio 24 0>;
    };
};
