/dts-v1/;

/ {
	compatible = "brcm,bcm2711";

	fragment@0 {
		target = <0xffffffff>;

		__overlay__ {
			status = "okay";
			compatible = "my,uart";
		};
	};

	__fixups__ {
		uart2 = "/fragment@0:target:0";
	};
};
