/dts-v1/;
/plugin/;

/ {
fragment@0 {
        target-path = "/";

        __overlay__ {
            led_gpio17 {
                compatible = "techdhaba,gpio-led";
                label = "gpio17-led";
                led-gpios = <&gpio0 17 1>;
                status = "okay";
            };
        };
    };
};
