/dts-v1/;
/plugin/;

/ {
    compatible = "brcm,bcm2711";

    fragment@0 {
        target = <&soc>;
        __overlay__ {
            gpio_led: gpio_led {
                compatible = "custom,led";
                led-gpios = <&gpio 18 GPIO_ACTIVE_HIGH>;
                label = "LED";
                status = "okay";
            };
        };
    };
};
