/dts-v1/;
/plugin/;

/ {
    compatible = "brcm,bcm2711";

    /* Enable SPI1 */
    fragment@0 {
        target = <&spi1>;
        __overlay__ {
            status = "okay";
        };
    };

    /* Disable spidev@1 */
    fragment@1 {
        target-path = "/soc/spi@7e215080/spidev@1";
        __overlay__ {
            status = "disabled";
        };
    };

    /* Add ILI9225 */
    fragment@2 {
        target = <&spi1>;
        __overlay__ {

            #address-cells = <1>;
            #size-cells = <0>;

            ili9225@1 {
                compatible = "display,ili9225";
                reg = <1>;
                spi-max-frequency = <8000000>;

                dc-gpios = <&gpio 25 0>;
                reset-gpios = <&gpio 24 0>;

                status = "okay";
            };
        };
    };
};

