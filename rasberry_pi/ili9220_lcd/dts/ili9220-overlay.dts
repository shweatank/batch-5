/dts-v1/;
/plugin/;

/ {
    compatible = "brcm,bcm2711";

    fragment@0 {
        target = <&spi0>;
        __overlay__ {

            #address-cells = <1>;
            #size-cells = <0>;

            status = "okay";

            ili9220@0 {
                compatible = "ilitek,ili9220";
                reg = <0>;                     /* CS0 */
                spi-max-frequency = <16000000>;
                spi-mode = <0>;

                dc-gpios = <&gpio 25 0>;
                reset-gpios = <&gpio 24 0>;
            };
        };
    };
};

