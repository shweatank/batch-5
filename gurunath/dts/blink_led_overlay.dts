/dts-v1/;
/plugin/;

/ {
    compatible = "brcm,bcm2711";

    fragment@0 {
        target-path = "/";
        __overlay__ {
            blink_led {
                compatible = "techdhaba,blink-led";
                gpios = <&gpio 27 0>;  /* GPIO27 */
            };
        };
    };
};

