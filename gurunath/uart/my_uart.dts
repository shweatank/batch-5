/dts-v1/;
/plugin/;

/ {
    compatible = "brcm,bcm2711";

    fragment@0 {
        target-path = "/soc";
        __overlay__ {
            my_uart: my_uart@fe201000 {
                compatible = "my,my_uart";
                reg = <0x0 0xfe201000 0x00001000>; /* 64-bit address + 32-bit size */
            };
        };
    };
};


