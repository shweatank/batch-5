/dts-v1/;
/plugin/;

/ {
    compatible = "brcm,bcm2835";

    fragment@0 {
        target = <&spi0>;
        __overlay__ {
            status = "okay";

            ili9225: ili9225@1 {
                compatible = "ilitek,ili9225";
                reg = <1>;                      // CE0
                spi-max-frequency = <16000000>; // 16 MHz

                dc-gpios = <&gpio 25 0>;        // GPIO25
                reset-gpios = <&gpio 24 0>;     // GPIO24
            };
        };
    };
};
