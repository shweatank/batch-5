/dts-v1/;
/plugin/;

/ {
    compatible = "brcm,bcm2835";

    fragment@0 {
        target-path = "/";
        __overlay__ {
            hcsr04 {
                compatible = "mycompany,hcsr04";

                trig-gpios   = <&gpio 5 0>;
                echo-gpios   = <&gpio 6 0>;
                led-close-gpios = <&gpio 17 0>;  // approaching LED
                led-far-gpios   = <&gpio 27 0>;  // moving away LED
                buzzer-gpios    = <&gpio 22 0>;  // buzzer
            };
        };
    };
};
