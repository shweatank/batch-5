/dts-v1/;
/plugin/;

/ {
    compatible = "brcm,bcm2711";

    fragment@0 {
        target = <&spi0>;
        __overlay__ {
            #address-cells = <1>;
            #size-cells = <0>;

            ultra@0 {
                compatible = "mycompany,ultra-lcd";
                reg = <0>;
                spi-max-frequency = <4000000>;

                dc-gpios = <&gpio 25 0>;
                reset-gpios = <&gpio 24 0>;

                trig-gpios = <&gpio 5 0>;
                echo-gpios = <&gpio 6 0>;
            };
        };
    };
};
