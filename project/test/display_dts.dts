/dts-v1/;
/plugin/;

/ {
    compatible = "brcm,bcm2711";

    fragment@0 {
        target = <&spi0>;   // SPI0 bus
        __overlay__ {
            #address-cells = <1>;
            #size-cells = <0>;
            
            ili9225: ili9225@0 {
                compatible = "ilitek,ili9225";
                reg = <0>;            // CE0
                spi-max-frequency = <8000000>;

                reset-gpios = <&gpio 24 0>;
                dc-gpios = <&gpio 25 0>;
                status = "okay";
            };
        };
    };
};

